## templates/yocto/layer-distro/meta-___name___/conf/distro/___name___.conf
```bitbake
DISTRO = "{{ name }}"
DISTRO_NAME = "{{ name }}"
DISTRO_VERSION = "1.0"
DISTRO_CODENAME = "{{ branch }}"
SDK_VENDOR = "-{{ name }}sdk"
SDK_VERSION = "${%raw%}{{%endraw%}@d.getVar('DISTRO_VERSION').replace('snapshot-${%raw%}{{%endraw%}DATE{%raw%}}{%endraw%}', 'snapshot'){%raw%}}{%endraw%}"

MAINTAINER = "{{ maintainer_name}} <{{ maintainer_email }}>"

TARGET_VENDOR = "-{{ name }}"

LOCALCONF_VERSION = "1"

DISTRO_VERSION[vardepsexclude] = "DATE"
SDK_VERSION[vardepsexclude] = "DATE"

# Override these in poky based distros
{{ name.upper() }}_DEFAULT_DISTRO_FEATURES = "largefile opengl ptest multiarch wayland vulkan"
{{ name.upper() }}_DEFAULT_EXTRA_RDEPENDS = "packagegroup-core-boot"
{{ name.upper() }}_DEFAULT_EXTRA_RRECOMMENDS = "kernel-module-af-packet"

DISTRO_FEATURES ?= "${%raw%}{{%endraw%}DISTRO_FEATURES_DEFAULT{%raw%}}{%endraw%} ${%raw%}{{%endraw%}{{ name.upper() }}_DEFAULT_DISTRO_FEATURES{%raw%}}{%endraw%}"

PREFERRED_VERSION_linux-yocto ?= "5.8%"
PREFERRED_VERSION_linux-yocto-rt ?= "5.4%"

SDK_NAME = "${%raw%}{{%endraw%}DISTRO{%raw%}}{%endraw%}-${%raw%}{{%endraw%}TCLIBC{%raw%}}{%endraw%}-${%raw%}{{%endraw%}SDKMACHINE{%raw%}}{%endraw%}-${%raw%}{{%endraw%}IMAGE_BASENAME{%raw%}}{%endraw%}-${%raw%}{{%endraw%}TUNE_PKGARCH{%raw%}}{%endraw%}-${%raw%}{{%endraw%}MACHINE{%raw%}}{%endraw%}"
SDKPATH = "/opt/${%raw%}{{%endraw%}DISTRO{%raw%}}{%endraw%}/${%raw%}{{%endraw%}SDK_VERSION{%raw%}}{%endraw%}"

DISTRO_EXTRA_RDEPENDS += " ${%raw%}{{%endraw%}{{ name.upper() }}_DEFAULT_EXTRA_RDEPENDS{%raw%}}{%endraw%}"
DISTRO_EXTRA_RRECOMMENDS += " ${%raw%}{{%endraw%}{{ name.upper() }}_DEFAULT_EXTRA_RRECOMMENDS{%raw%}}{%endraw%}"

TCLIBCAPPEND = ""

PREMIRRORS ??= "\
bzr://.*/.*   http://downloads.yoctoproject.org/mirror/sources/ \n \
cvs://.*/.*   http://downloads.yoctoproject.org/mirror/sources/ \n \
git://.*/.*   http://downloads.yoctoproject.org/mirror/sources/ \n \
gitsm://.*/.* http://downloads.yoctoproject.org/mirror/sources/ \n \
hg://.*/.*    http://downloads.yoctoproject.org/mirror/sources/ \n \
osc://.*/.*   http://downloads.yoctoproject.org/mirror/sources/ \n \
p4://.*/.*    http://downloads.yoctoproject.org/mirror/sources/ \n \
svn://.*/.*   http://downloads.yoctoproject.org/mirror/sources/ \n"

SANITY_TESTED_DISTROS ?= " \
            poky-3.0 \n \
            poky-3.1 \n \
            poky-3.2 \n \
            ubuntu-16.04 \n \
            ubuntu-18.04 \n \
            ubuntu-20.04 \n \
            fedora-30 \n \
            fedora-31 \n \
            fedora-32 \n \
            centos-7 \n \
            centos-8 \n \
            debian-8 \n \
            debian-9 \n \
            debian-10 \n \
            opensuseleap-15.1 \n \
            "
# add poky sanity bbclass
INHERIT += "poky-sanity"

# QA check settings - a little stricter than the OE-Core defaults
# (none currently necessary as we now match OE-Core)
#WARN_TO_ERROR_QA = "X"
#WARN_QA_remove = "${%raw%}{{%endraw%}WARN_TO_ERROR_QA{%raw%}}{%endraw%}"
#ERROR_QA_append = " ${%raw%}{{%endraw%}WARN_TO_ERROR_QA{%raw%}}{%endraw%}"

require conf/distro/include/poky-world-exclude.inc
require conf/distro/include/no-static-libs.inc
require conf/distro/include/yocto-uninative.inc
require conf/distro/include/security_flags.inc
INHERIT += "uninative"

INHERIT += "reproducible_build"

BB_SIGNATURE_HANDLER ?= "OEEquivHash"
BB_HASHSERVE ??= "auto"
```

## templates/yocto/layer-distro/meta-___name___/conf/layer.conf
```bitbake
# We have a conf and classes directory, add to BBPATH
BBPATH =. "${LAYERDIR}:"

# We have recipes-* directories, add to BBFILES
BBFILES += "${LAYERDIR}/recipes-*/*/*.bb \
            ${LAYERDIR}/recipes-*/*/*.bbappend"

BBFILE_COLLECTIONS += "meta-{{ name }}"
BBFILE_PATTERN_meta-{{ name }} = "^${LAYERDIR}/"
BBFILE_PRIORITY_meta-{{ name }} = "5"

LAYERSERIES_COMPAT_meta-{{ name }} = "gatesgarth"

# This should only be incremented on significant changes that will
# cause compatibility issues with other layers
LAYERVERSION_meta-{{ name }} = "3"

LAYERDEPENDS_meta-{{ name }} = "{{ dependencies }}"

REQUIRED_POKY_BBLAYERS_CONF_VERSION = "2"
```
